## configs/CHIP_defconfig
```kconfig
CONFIG_ARM=y
CONFIG_ARCH_SUNXI=y
CONFIG_MACH_SUN5I=y
CONFIG_DRAM_TIMINGS_DDR3_800E_1066G_1333J=y
# CONFIG_MMC is not set
CONFIG_USB0_VBUS_PIN="PB10"
CONFIG_I2C1_ENABLE=y
CONFIG_AXP_GPIO=y
# CONFIG_VIDEO_HDMI is not set
CONFIG_VIDEO_VGA_VIA_LCD=y
CONFIG_VIDEO_COMPOSITE=y
CONFIG_VIDEO_LCD_MODE="x:320,y:240,depth:24,pclk_khz:7000,le:38,ri:20,up:15,lo:4,hs:30,vs:3,sync:3,vmode:0"
CONFIG_VIDEO_LCD_POWER="AXP0-1"
CONFIG_VIDEO_LCD_BL_EN="PB2"
CONFIG_CHIP_DIP=y
CONFIG_DEFAULT_DEVICE_TREE="sun5i-r8-chip"
CONFIG_SPL=y
CONFIG_SYS_EXTRA_OPTIONS="CONS_INDEX=2,SPLASH_SCREEN_ALIGN,CMD_BMP,VIDEO_BMP_LOGO,ENV_IS_IN_NAND"
# CONFIG_CMD_IMLS is not set
CONFIG_CMD_GPIO=y
CONFIG_NAND_SUNXI=y
CONFIG_SPL_NAND_U_BOOT_OFFS=0x800000
CONFIG_EEPROM=y
CONFIG_EEPROM_DS2431=y
CONFIG_AXP_ALDO3_VOLT=3300
CONFIG_AXP_ALDO4_VOLT=3300
CONFIG_USB_MUSB_GADGET=y
CONFIG_VIDEO_CHRONTEL_CH7033=y
CONFIG_VIDEO_CHRONTEL_CH7033_I2C_BUS=1
CONFIG_W1=y
CONFIG_W1_GPIO=y
```
